## buildroot/Config.in
```kconfig
config BR2_PACKAGE_UNIONFS
	bool "dynfilefs (FUSE)"
	depends on BR2_TOOLCHAIN_HAS_THREADS # libfuse
	depends on BR2_USE_MMU # libfuse
	select BR2_PACKAGE_LIBFUSE
	help
	  dynfilefs filesystem support using fuse

comment "dynfilefs needs a toolchain w/ wchar, threads"
	depends on BR2_USE_MMU
	depends on !BR2_USE_WCHAR || !BR2_TOOLCHAIN_HAS_THREADS
```
